## CMakeLists.txt
```
cmake_minimum_required(VERSION 3.20.0)
set(KCONFIG_ROOT ${CMAKE_CURRENT_SOURCE_DIR}/Kconfig)

# Default board — override with: west build -b <board>
if(NOT DEFINED BOARD)
  set(BOARD cy8cproto_062_4343w)
endif()

find_package(Zephyr REQUIRED HINTS $ENV{ZEPHYR_BASE})
project(zephyr_psoc6)
# This tells Zephyr where to find your custom Kconfig definitions
target_sources(app PRIVATE src/main.c src/wifi_module.c src/mqtt_module.c src/uart_rx.c)
```

## Kconfig
```
mainmenu "My Blinky Project"

menu "App Configuration"
    config BLINK_SLEEP_MS
        int "Sleep time in milliseconds"
        default 1000
        range 100 5000
        help
            Time to sleep between toggling the LED.

    config WIFI_SSID
        string "APP_WIFI_SSID"
        default ""
        help
            SSID for station connection.

    config WIFI_PSK
        string "APP_WIFI_PSK"
        default ""
        help
            WPA2 passphrase for station connection.

    config MQTT_BROKER_HOST
        string "MQTT broker host"
        default "test.mosquitto.org"
        help
            Hostname or IPv4 address of the MQTT broker.

    config MQTT_BROKER_PORT
        int "MQTT broker port"
        default 1883
        range 1 65535
        help
            MQTT broker TCP port.

    config MQTT_CLIENT_ID
        string "MQTT client ID"
        default "psoc6-debug-client"
        help
            Client ID used to connect to the MQTT broker.

   config MQTT_DEBUG_TOPIC
        string "MQTT debug publish topic"
        default "psoc6/debug"
        help
            Topic used for periodic debug messages.

    config MQTT_PUBLISH_INTERVAL_SEC
        int "MQTT debug publish interval (seconds)"
        default 10
        range 1 3600
        help
            Interval for publishing periodic debug messages.




endmenu

source "Kconfig.zephyr"
```

## prj.conf
```kconfig
CONFIG_GPIO=y
CONFIG_SERIAL=y
CONFIG_CONSOLE=y
CONFIG_UART_CONSOLE=y
CONFIG_SHELL=n
CONFIG_UART_INTERRUPT_DRIVEN=y
CONFIG_PRINTK=y
CONFIG_BLINK_SLEEP_MS=200
CONFIG_LOG=y

# Networking / Wi-Fi
CONFIG_NETWORKING=y
CONFIG_NET_MGMT=y
CONFIG_NET_MGMT_EVENT=y
CONFIG_NET_IPV4=y
CONFIG_NET_IPV6=n
CONFIG_NET_TCP=y
CONFIG_NET_UDP=y
CONFIG_NET_SOCKETS=y
CONFIG_DNS_RESOLVER=y
CONFIG_TEST_RANDOM_GENERATOR=y
# Set these in a local overlay for your network.
CONFIG_WIFI_SSID="Abhaile"
CONFIG_WIFI_PSK="Moran1977"
# CONFIG_MQTT_BROKER_HOST="192.168.1.124"
# Networking
CONFIG_MQTT_LIB=y
# WiFi / L2 (already needed for your SSID/PSK)
CONFIG_WIFI=y
CONFIG_NET_L2_WIFI_MGMT=y
CONFIG_NET_DHCPV4=y

# Threads
CONFIG_MAIN_STACK_SIZE=4096
```

## boards/native_sim.conf
```kconfig
# native_sim: no Wi-Fi hardware — use host offloaded sockets.
# Zephyr POSIX target is Linux-only; build/run on WSL or Linux (not native macOS).
CONFIG_WIFI=n
CONFIG_NET_L2_WIFI_MGMT=n

CONFIG_ETH_NATIVE_TAP=n
CONFIG_NET_DRIVERS=y
CONFIG_NET_SOCKETS_OFFLOAD=y
CONFIG_NET_NATIVE_OFFLOADED_SOCKETS=y
CONFIG_NET_IPV6_DAD=n

CONFIG_POSIX_API=y

# Host provides routing; disable Zephyr Wi-Fi DHCP client path.
CONFIG_NET_DHCPV4=n
```

## app.overlay
```dts
/*
 * Board-specific devicetree is under boards/<board>.overlay so targets
 * like native_sim are not broken by PSoC-only node references (uart5, dma).
 */
/ {
};
```

## boards/cy8cproto_062_4343w.overlay
```dts
/ {
	chosen {
		zephyr,sram = &sram0;
		zephyr,flash = &flash0;
		zephyr,console = &uart5;
		zephyr,shell-uart = &uart5;
	};
};

&uart5 {
	dmas = <&dma0 0>, <&dma0 1>;
	dma-names = "tx", "rx";
};
```

## src/main.c
```c
#include <zephyr/kernel.h>
#include <zephyr/drivers/gpio.h>
#include <zephyr/devicetree.h>
#include <zephyr/logging/log.h>
#include "mqtt_module.h"
#include "wifi_module.h"
#include "uart_rx.h"

#define LED0_NODE DT_NODELABEL(user_led)

#if DT_NODE_HAS_STATUS(LED0_NODE, okay)
static const struct gpio_dt_spec led = GPIO_DT_SPEC_GET(LED0_NODE, gpios);
#define HAS_USER_LED 1
#else
#define HAS_USER_LED 0
#endif

LOG_MODULE_REGISTER(app, LOG_LEVEL_INF);

int main(void)
{
	int err;

#if HAS_USER_LED
	if (!gpio_is_ready_dt(&led)) {
		LOG_ERR("LED device not ready");
		return -ENODEV;
	}

	gpio_pin_configure_dt(&led, GPIO_OUTPUT_ACTIVE);
#endif

	err = app_wifi_init();
	if (err) {
		LOG_ERR("Wi-Fi module init failed (%d)", err);
	}

	err = app_wifi_connect();
	if (err) {
		LOG_ERR("Wi-Fi init failed (%d)", err);
	}

	err = app_mqtt_init();
	if (err) {
		LOG_ERR("MQTT module init failed (%d)", err);
	}

	err = uart_rx_init();
	if (err) {
		LOG_ERR("UART RX init failed (%d)", err);
	}

	while (1) {
		app_wifi_task();
		app_mqtt_task(app_wifi_has_ipv4());
#if HAS_USER_LED
		gpio_pin_toggle_dt(&led);
#endif
		k_msleep(CONFIG_BLINK_SLEEP_MS);
	}

	return 0;
}
```

## src/mqtt_module.c
```c
#include "mqtt_module.h"

#include <zephyr/kernel.h>
#include <zephyr/logging/log.h>
#include <zephyr/net/mqtt.h>
#include <zephyr/net/socket.h>

#include <errno.h>
#include <stdio.h>
#include <string.h>

LOG_MODULE_REGISTER(app_mqtt, LOG_LEVEL_INF);

#define MQTT_RX_BUFFER_SIZE 256
#define MQTT_TX_BUFFER_SIZE 256
#define MQTT_PAYLOAD_SIZE   128

static struct mqtt_client client;
static struct sockaddr_storage broker_storage;
static uint8_t rx_buffer[MQTT_RX_BUFFER_SIZE];
static uint8_t tx_buffer[MQTT_TX_BUFFER_SIZE];
static char payload_buffer[MQTT_PAYLOAD_SIZE];
static uint16_t message_id;
static bool mqtt_connected;
static int64_t next_connect_ms;
static int64_t next_publish_ms;

static void mqtt_event_handler(struct mqtt_client *const c, const struct mqtt_evt *evt)
{
	ARG_UNUSED(c);

	switch (evt->type) {
	case MQTT_EVT_CONNACK:
		if (evt->result == 0) {
			mqtt_connected = true;
			next_publish_ms = k_uptime_get();
			LOG_INF("MQTT connected");
		} else {
			LOG_ERR("MQTT connack error: %d", evt->result);
		}
		break;
	case MQTT_EVT_DISCONNECT:
		mqtt_connected = false;
		LOG_WRN("MQTT disconnected (%d)", evt->result);
		break;
	case MQTT_EVT_PUBACK:
		LOG_INF("MQTT publish ack id=%u", evt->param.puback.message_id);
		break;
	default:
		break;
	}
}

static int resolve_broker(struct sockaddr_storage *storage)
{
	struct sockaddr_in *addr4 = (struct sockaddr_in *)storage;
	struct zsock_addrinfo hints = {
		.ai_family = AF_INET,
		.ai_socktype = SOCK_STREAM,
	};
	struct zsock_addrinfo *res = NULL;
	char port_str[8];
	int ret;

	/* Allow literal IPv4 broker values and skip DNS in that case. */
	if (zsock_inet_pton(AF_INET, CONFIG_MQTT_BROKER_HOST, &addr4->sin_addr) == 1) {
		addr4->sin_family = AF_INET;
		addr4->sin_port = htons(CONFIG_MQTT_BROKER_PORT);
		return 0;
	}

	snprintk(port_str, sizeof(port_str), "%d", CONFIG_MQTT_BROKER_PORT);
	ret = zsock_getaddrinfo(CONFIG_MQTT_BROKER_HOST, port_str, &hints, &res);
	if (ret != 0 || !res) {
		if (ret == -EAGAIN) {
			LOG_WRN("MQTT DNS not ready yet for %s:%s (%d)", CONFIG_MQTT_BROKER_HOST,
				port_str, ret);
			return -EAGAIN;
		}
		LOG_ERR("MQTT DNS resolve failed for %s:%s (%d)", CONFIG_MQTT_BROKER_HOST, port_str,
			ret);
		return ret ? ret : -ENOENT;
	}

	memcpy(storage, res->ai_addr, res->ai_addrlen);
	zsock_freeaddrinfo(res);
	return 0;
}

static int mqtt_try_connect(void)
{
	int ret;

	ret = resolve_broker(&broker_storage);
	if (ret) {
		return ret;
	}

	mqtt_client_init(&client);
	client.broker = &broker_storage;
	client.evt_cb = mqtt_event_handler;
	client.client_id.utf8 = (uint8_t *)CONFIG_MQTT_CLIENT_ID;
	client.client_id.size = strlen(CONFIG_MQTT_CLIENT_ID);
	client.password = NULL;
	client.user_name = NULL;
	client.protocol_version = MQTT_VERSION_3_1_1;
	client.transport.type = MQTT_TRANSPORT_NON_SECURE;
	client.rx_buf = rx_buffer;
	client.rx_buf_size = sizeof(rx_buffer);
	client.tx_buf = tx_buffer;
	client.tx_buf_size = sizeof(tx_buffer);
	client.keepalive = 30U;

	ret = mqtt_connect(&client);
	if (ret) {
		LOG_ERR("mqtt_connect failed (%d)", ret);
		return ret;
	}

	LOG_INF("MQTT connecting to %s:%d", CONFIG_MQTT_BROKER_HOST, CONFIG_MQTT_BROKER_PORT);
	return 0;
}

static void mqtt_disconnect_cleanup(void)
{
	if (client.transport.type == MQTT_TRANSPORT_NON_SECURE && client.transport.tcp.sock >= 0) {
		(void)zsock_close(client.transport.tcp.sock);
		client.transport.tcp.sock = -1;
	}
	mqtt_connected = false;
}

static int mqtt_publish_debug(bool net_ready)
{
	struct mqtt_publish_param param;
	int len;
	int ret;

	len = snprintk(payload_buffer, sizeof(payload_buffer),
		       "{\"uptime_ms\":%lu,\"wifi_up\":%d}",
		       (unsigned long)k_uptime_get(), net_ready ? 1 : 0);
	if (len <= 0 || len >= sizeof(payload_buffer)) {
		return -ENOMEM;
	}

	memset(&param, 0, sizeof(param));
	param.message.topic.qos = MQTT_QOS_0_AT_MOST_ONCE;
	param.message.topic.topic.utf8 = (uint8_t *)CONFIG_MQTT_DEBUG_TOPIC;
	param.message.topic.topic.size = strlen(CONFIG_MQTT_DEBUG_TOPIC);
	param.message.payload.data = payload_buffer;
	param.message.payload.len = len;
	param.message_id = ++message_id;
	param.dup_flag = 0U;
	param.retain_flag = 0U;

	ret = mqtt_publish(&client, &param);
	if (ret) {
		LOG_ERR("MQTT publish failed (%d)", ret);
		return ret;
	}

	LOG_INF("MQTT debug published topic=%s", CONFIG_MQTT_DEBUG_TOPIC);
	return 0;
}

int app_mqtt_init(void)
{
	memset(&client, 0, sizeof(client));
	client.transport.type = MQTT_TRANSPORT_NON_SECURE;
	client.transport.tcp.sock = -1;
	mqtt_connected = false;
	message_id = 0U;
	next_connect_ms = k_uptime_get();
	next_publish_ms = next_connect_ms + (CONFIG_MQTT_PUBLISH_INTERVAL_SEC * MSEC_PER_SEC);
	return 0;
}

void app_mqtt_task(bool net_ready)
{
	int ret;
	int64_t now = k_uptime_get();

	if (!net_ready) {
		if (mqtt_connected) {
			(void)mqtt_disconnect(&client, NULL);
		}
		mqtt_disconnect_cleanup();
		next_connect_ms = now + 3000;
		return;
	}

	if (!mqtt_connected && now >= next_connect_ms) {
		ret = mqtt_try_connect();
		if (ret) {
			next_connect_ms = now + 2000;
			return;
		}
		next_connect_ms = now + 2000;
	}

	if (client.transport.type == MQTT_TRANSPORT_NON_SECURE && client.transport.tcp.sock >= 0) {
		(void)mqtt_input(&client);
		(void)mqtt_live(&client);
	}

	if (mqtt_connected && now >= next_publish_ms) {
		ret = mqtt_publish_debug(net_ready);
		if (ret) {
			mqtt_disconnect_cleanup();
			next_connect_ms = now + 2000;
		}
		next_publish_ms = now + (CONFIG_MQTT_PUBLISH_INTERVAL_SEC * MSEC_PER_SEC);
	}
}
```

## src/mqtt_module.h
```c
#ifndef MQTT_MODULE_H_
#define MQTT_MODULE_H_

#include <stdbool.h>

int app_mqtt_init(void);
void app_mqtt_task(bool net_ready);

#endif /* MQTT_MODULE_H_ */
```

## src/uart_rx.c
```c
#include <zephyr/kernel.h>
#include <zephyr/drivers/uart.h>
#include <zephyr/logging/log.h>

LOG_MODULE_REGISTER(uart_rx, LOG_LEVEL_INF);

#define UART_DEVICE_NODE DT_NODELABEL(uart5)
#define RX_BUF_SIZE 64

static const struct device *uart_dev = DEVICE_DT_GET(UART_DEVICE_NODE);
static uint8_t rx_buf[RX_BUF_SIZE];
static bool rx_enabled;

void uart_cb(const struct device *dev, void *user_data)
{
	int len;

	while (uart_irq_update(dev) && uart_irq_is_pending(dev)) {
		if (!uart_irq_rx_ready(dev)) {
			continue;
		}

		len = uart_fifo_read(dev, rx_buf, RX_BUF_SIZE);
		if (len > 0) {
			for (int i = 0; i < len; i++) {
				LOG_INF("Received: 0x%02x ('%c')", rx_buf[i],
					(rx_buf[i] >= 32 && rx_buf[i] < 127) ? rx_buf[i] : '.');
			}
		}
	}
}

int uart_rx_init(void)
{
	if (!device_is_ready(uart_dev)) {
		LOG_ERR("UART device not ready");
		return -ENODEV;
	}

	uart_irq_callback_set(uart_dev, uart_cb);
	uart_irq_rx_enable(uart_dev);
	rx_enabled = true;

	LOG_INF("UART RX initialized on %s", uart_dev->name);
	return 0;
}
```

## src/uart_rx.h
```c
#ifndef UART_RX_H
#define UART_RX_H

int uart_rx_init(void);

#endif /* UART_RX_H */
```

## src/udp.c
```c
#include <zephyr/kernel.h>
#include <zephyr/net/socket.h>
#include <zephyr/logging/log.h>
#include <string.h>
#include "udp.h"

LOG_MODULE_REGISTER(udp_module, LOG_LEVEL_DBG);

static int sock = -1;
static struct sockaddr_in remote_addr;

K_THREAD_STACK_DEFINE(udp_rx_stack, CONFIG_UDP_STACK_SIZE);
static struct k_thread udp_rx_thread;

static void udp_rx_handler(void *p1, void *p2, void *p3)
{
    uint8_t buf[CONFIG_UDP_BUF_SIZE];
    struct sockaddr_in src;
    socklen_t src_len = sizeof(src);

    while (1) {
        ssize_t received = recvfrom(sock, buf, sizeof(buf) - 1, 0,
                                    (struct sockaddr *)&src, &src_len);
        if (received < 0) {
            LOG_ERR("recvfrom error: %d", errno);
            k_sleep(K_MSEC(100));
            continue;
        }
        buf[received] = '\0';
        LOG_INF("UDP RX [%d bytes]: %s", (int)received, buf);

        /* TODO: dispatch buf to your application logic here */
    }
}

int udp_start(void)
{
    struct sockaddr_in local_addr = {
        .sin_family = AF_INET,
        .sin_port   = htons(CONFIG_UDP_LOCAL_PORT),
        .sin_addr   = { .s_addr = INADDR_ANY },
    };

    sock = socket(AF_INET, SOCK_DGRAM, IPPROTO_UDP);
    if (sock < 0) {
        LOG_ERR("socket() failed: %d", errno);
        return -errno;
    }

    if (bind(sock, (struct sockaddr *)&local_addr, sizeof(local_addr)) < 0) {
        LOG_ERR("bind() failed: %d", errno);
        close(sock);
        sock = -1;
        return -errno;
    }

    /* Pre-fill remote address from Kconfig */
    remote_addr.sin_family = AF_INET;
    remote_addr.sin_port   = htons(CONFIG_UDP_REMOTE_PORT);
    net_addr_pton(AF_INET, CONFIG_UDP_REMOTE_HOST, &remote_addr.sin_addr);

    k_thread_create(&udp_rx_thread, udp_rx_stack,
                    K_THREAD_STACK_SIZEOF(udp_rx_stack),
                    udp_rx_handler, NULL, NULL, NULL,
                    K_PRIO_COOP(7), 0, K_NO_WAIT);
    k_thread_name_set(&udp_rx_thread, "udp_rx");

    LOG_INF("UDP socket bound on port %d, remote %s:%d",
            CONFIG_UDP_LOCAL_PORT,
            CONFIG_UDP_REMOTE_HOST,
            CONFIG_UDP_REMOTE_PORT);
    return 0;
}

int udp_send(const uint8_t *buf, size_t len)
{
    if (sock < 0) {
        return -ENOTCONN;
    }
    ssize_t sent = sendto(sock, buf, len, 0,
                          (struct sockaddr *)&remote_addr,
                          sizeof(remote_addr));
    if (sent < 0) {
        LOG_ERR("sendto() failed: %d", errno);
        return -errno;
    }
    return (int)sent;
}
```

## src/udp.h
```c
#ifndef UDP_H
#define UDP_H

#include <zephyr/kernel.h>

/**
 * Start the UDP receive thread and open the socket.
 * Call this after WiFi + DHCP are up.
 */
int udp_start(void);

/**
 * Send a datagram to the configured remote host/port.
 * @param buf  data to send
 * @param len  number of bytes
 * @return     bytes sent, or negative errno
 */
int udp_send(const uint8_t *buf, size_t len);

#endif /* UDP_H */
```

## src/wifi_module.c
```c
#include "wifi_module.h"

#include <zephyr/kernel.h>
#include <zephyr/net/net_if.h>
#include <zephyr/net/net_ip.h>
#include <zephyr/logging/log.h>
#include <zephyr/sys/util.h>

#if IS_ENABLED(CONFIG_WIFI)

#include <zephyr/net/net_event.h>
#include <zephyr/net/net_mgmt.h>
#include <zephyr/net/dns_resolve.h>
#include <zephyr/net/socket.h>
#include <zephyr/net/wifi_mgmt.h>
#include "udp.h"
#include <errno.h>
#include <string.h>

LOG_MODULE_REGISTER(app_wifi, LOG_LEVEL_INF);

static struct net_mgmt_event_callback net_cb;
static struct net_if *wifi_iface;
static bool wifi_link_logged_up;
static bool wifi_prev_up;

static void log_ipv4_network_details(struct net_if *iface, struct net_if_ipv4 *ipv4)
{
	char ip_buf[NET_IPV4_ADDR_LEN];
	char gw_buf[NET_IPV4_ADDR_LEN];
#if defined(CONFIG_NET_DHCPV4)
	char mask_buf[NET_IPV4_ADDR_LEN];
#endif
	struct dns_resolve_context *dns_ctx;
	int if_index;

	if_index = net_if_get_by_iface(iface);
	(void)net_addr_ntop(AF_INET, &ipv4->unicast[0].ipv4.address.in_addr, ip_buf, sizeof(ip_buf));
	(void)net_addr_ntop(AF_INET, &ipv4->gw, gw_buf, sizeof(gw_buf));
	LOG_INF("IPv4 details: if=%d ip=%s gw=%s", if_index, ip_buf, gw_buf);

#if defined(CONFIG_NET_DHCPV4)
	if (net_if_get_config(iface)) {
		(void)net_addr_ntop(AF_INET, &net_if_get_config(iface)->dhcpv4.netmask, mask_buf,
				    sizeof(mask_buf));
		LOG_INF("IPv4 details: netmask=%s", mask_buf);
	}
#endif

	dns_ctx = dns_resolve_get_default();
	if (!dns_ctx) {
		LOG_WRN("DNS context is not available");
		return;
	}

	for (size_t i = 0; i < ARRAY_SIZE(dns_ctx->servers); i++) {
		const struct sockaddr *sa = &dns_ctx->servers[i].dns_server;
		char dns_buf[NET_IPV6_ADDR_LEN];

		if (sa->sa_family == AF_UNSPEC) {
			continue;
		}

		if (sa->sa_family == AF_INET) {
			const struct sockaddr_in *sin = (const struct sockaddr_in *)sa;

			(void)net_addr_ntop(AF_INET, &sin->sin_addr, dns_buf, sizeof(dns_buf));
			LOG_INF("DNS server[%u]: %s if=%d source=%d", (unsigned int)i, dns_buf,
				dns_ctx->servers[i].if_index, dns_ctx->servers[i].source);
		} else if (sa->sa_family == AF_INET6) {
			const struct sockaddr_in6 *sin6 = (const struct sockaddr_in6 *)sa;

			(void)net_addr_ntop(AF_INET6, &sin6->sin6_addr, dns_buf, sizeof(dns_buf));
			LOG_INF("DNS server[%u]: %s if=%d source=%d", (unsigned int)i, dns_buf,
				dns_ctx->servers[i].if_index, dns_ctx->servers[i].source);
		}
	}
}

#define WIFI_EVENTS                                                                            \
	(NET_EVENT_WIFI_CONNECT_RESULT | NET_EVENT_WIFI_DISCONNECT_RESULT | NET_EVENT_IPV4_ADDR_ADD | \
	 NET_EVENT_IF_UP)

static void on_net_event(struct net_mgmt_event_callback *cb, uint64_t event, struct net_if *iface)
{
	if (iface && iface != wifi_iface) {
		return;
	}

	if (event == NET_EVENT_WIFI_CONNECT_RESULT) {
		const struct wifi_status *status = cb->info;

		if (status && status->status) {
			LOG_ERR("Wi-Fi connect failed: %d", status->status);
		} else {
			LOG_INF("Wi-Fi connected, waiting for DHCP IPv4");
		}
	} else if (event == NET_EVENT_WIFI_DISCONNECT_RESULT) {
		const struct wifi_status *status = cb->info;

		LOG_INF("Wi-Fi disconnected (reason=%d)", status ? status->status : 0);
	} else if (event == NET_EVENT_IF_UP) {
		LOG_INF("Network interface is up");
		wifi_link_logged_up = true;
	} else if (event == NET_EVENT_IPV4_ADDR_ADD) {
		char addr_buf[NET_IPV4_ADDR_LEN];
		struct net_if_ipv4 *ipv4 = NULL;
		struct net_if *active_iface = iface ? iface : wifi_iface;

		if (net_if_config_ipv4_get(active_iface, &ipv4) == 0 && ipv4 &&
		    ipv4->unicast[0].ipv4.is_used) {
			LOG_INF("IPv4 address: %s",
				net_addr_ntop(AF_INET, &ipv4->unicast[0].ipv4.address.in_addr, addr_buf,
					      sizeof(addr_buf)));
			log_ipv4_network_details(active_iface, ipv4);
		}
	}
}

int app_wifi_init(void)
{
	wifi_iface = net_if_get_wifi_sta();
	if (!wifi_iface) {
		wifi_iface = net_if_get_default();
	}
	if (!wifi_iface) {
		LOG_ERR("No default network interface");
		return -ENODEV;
	}

	wifi_link_logged_up = false;
	wifi_prev_up = net_if_is_up(wifi_iface);

	net_mgmt_init_event_callback(&net_cb, on_net_event, WIFI_EVENTS);
	net_mgmt_add_event_callback(&net_cb);

	return 0;
}

int app_wifi_connect(void)
{
	struct wifi_connect_req_params params = {0};
	int ret;
	int attempt;

	if (!wifi_iface) {
		LOG_ERR("Wi-Fi module not initialized");
		return -EINVAL;
	}

	if (strlen(CONFIG_WIFI_SSID) == 0U) {
		LOG_ERR("CONFIG_WIFI_SSID is empty. Set it in prj.conf/overlay.");
		return -EINVAL;
	}

	params.ssid = (const uint8_t *)CONFIG_WIFI_SSID;
	params.ssid_length = strlen(CONFIG_WIFI_SSID);
	params.psk = (const uint8_t *)CONFIG_WIFI_PSK;
	params.psk_length = strlen(CONFIG_WIFI_PSK);
	params.security = params.psk_length > 0U ? WIFI_SECURITY_TYPE_PSK : WIFI_SECURITY_TYPE_NONE;
	params.channel = WIFI_CHANNEL_ANY;
	params.band = WIFI_FREQ_BAND_2_4_GHZ;

	LOG_INF("Wi-Fi connect request: ssid_len=%u psk_len=%u security=%d band=2.4GHz",
		params.ssid_length, params.psk_length, params.security);

	for (attempt = 1; attempt <= 3; attempt++) {
		ret = net_mgmt(NET_REQUEST_WIFI_CONNECT, wifi_iface, &params, sizeof(params));
		if (ret == 0) {
			LOG_INF("Wi-Fi join request accepted for SSID: %s", CONFIG_WIFI_SSID);
			return 0;
		}

		if (ret != -EAGAIN || attempt == 3) {
			LOG_ERR("NET_REQUEST_WIFI_CONNECT failed (%d) on attempt %d/3", ret, attempt);
			return ret;
		}

		LOG_WRN("Connect busy (-EAGAIN), retrying (%d/3)...", attempt);
		k_sleep(K_SECONDS(2));
	}

	return -EAGAIN;
}

void app_wifi_task(void)
{
	bool now_up;

	if (!wifi_iface) {
		return;
	}

	now_up = net_if_is_up(wifi_iface);
	if (now_up && !wifi_prev_up && !wifi_link_logged_up) {
		LOG_INF("Wi-Fi link is up");
		wifi_link_logged_up = true;
	} else if (!now_up && wifi_prev_up) {
		LOG_WRN("Wi-Fi link went down");
		wifi_link_logged_up = false;
	}
	wifi_prev_up = now_up;
}

bool app_wifi_is_up(void)
{
	if (!wifi_iface) {
		return false;
	}

	return net_if_is_up(wifi_iface);
}

bool app_wifi_has_ipv4(void)
{
	struct net_if_ipv4 *ipv4 = NULL;

	if (!wifi_iface || !net_if_is_up(wifi_iface)) {
		return false;
	}

	if (net_if_config_ipv4_get(wifi_iface, &ipv4) != 0 || !ipv4) {
		return false;
	}

	return ipv4->unicast[0].ipv4.is_used;
}

#else /* !CONFIG_WIFI */

LOG_MODULE_REGISTER(app_wifi, LOG_LEVEL_INF);

static struct net_if *stub_iface;

int app_wifi_init(void)
{
	stub_iface = net_if_get_default();
	if (stub_iface) {
		LOG_INF("Wi-Fi stub: default net iface (no CONFIG_WIFI)");
	} else {
		LOG_WRN("Wi-Fi stub: no default network interface");
	}
	return 0;
}

int app_wifi_connect(void)
{
	LOG_INF("Wi-Fi stub: skip join");
	return 0;
}

void app_wifi_task(void)
{
}

bool app_wifi_is_up(void)
{
	if (!stub_iface) {
		return false;
	}
	return net_if_is_up(stub_iface);
}

bool app_wifi_has_ipv4(void)
{
	struct net_if_ipv4 *ipv4 = NULL;

	if (!stub_iface || !net_if_is_up(stub_iface)) {
		return false;
	}

	if (net_if_config_ipv4_get(stub_iface, &ipv4) != 0 || !ipv4) {
		return false;
	}

	return ipv4->unicast[0].ipv4.is_used;
}

#endif /* CONFIG_WIFI */
```

## src/wifi_module.h
```c
#ifndef WIFI_MODULE_H_
#define WIFI_MODULE_H_

#include <stdbool.h>

int app_wifi_init(void);
int app_wifi_connect(void);
void app_wifi_task(void);
bool app_wifi_is_up(void);
bool app_wifi_has_ipv4(void);

#endif /* WIFI_MODULE_H_ */
```
